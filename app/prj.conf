## CMakeLists.txt
```
cmake_minimum_required(VERSION 3.13.1)

find_package(Zephyr REQUIRED HINTS $ENV{ZEPHYR_BASE})
project(example-app)

target_sources(app PRIVATE src/main.c)
```

## Kconfig
```
mainmenu "Golioth application options"

if WIFI_ESP32

config ESP32_WIFI_SSID
	default GOLIOTH_SAMPLE_WIFI_SSID

config ESP32_WIFI_PASSWORD
	default GOLIOTH_SAMPLE_WIFI_PSK

endif # WIFI_ESP32

source "Kconfig.zephyr"
```

## prj.conf
```kconfig
# Generic networking options
CONFIG_NETWORKING=y
CONFIG_NET_IPV4=y
CONFIG_NET_IPV6=n

# Logging
CONFIG_NET_LOG=y

# Network Shell
CONFIG_NET_SHELL=y

# TLS configuration
CONFIG_MBEDTLS_ENABLE_HEAP=y
CONFIG_MBEDTLS_HEAP_SIZE=8192
CONFIG_MBEDTLS_SSL_MAX_CONTENT_LEN=2048

# Application
CONFIG_MAIN_STACK_SIZE=4096
CONFIG_EVENTFD=y

CONFIG_GOLIOTH=y
CONFIG_GOLIOTH_SYSTEM_CLIENT=y

CONFIG_LOG_BACKEND_GOLIOTH=y
CONFIG_LOG_PROCESS_THREAD_STACK_SIZE=2048

CONFIG_GOLIOTH_SYSTEM_CLIENT_PSK_ID="<the PSK ID>"
CONFIG_GOLIOTH_SYSTEM_CLIENT_PSK="<the PSK>"

CONFIG_ESP32_WIFI_SSID="<WIFI SSD>"
CONFIG_ESP32_WIFI_PASSWORD="<WIFI PASSWORD>"
```

## src/main.c
```c
/*
 * Copyright (c) 2021 Golioth, Inc.
 *
 * SPDX-License-Identifier: Apache-2.0
 */

#include <logging/log.h>
LOG_MODULE_REGISTER(golioth_logging, LOG_LEVEL_DBG);

#include <net/coap.h>
#include <net/golioth/system_client.h>
#include <net/golioth/wifi.h>

static struct golioth_client *client = GOLIOTH_SYSTEM_CLIENT_GET();

static void golioth_on_message(struct golioth_client *client,
                   struct coap_packet *rx)
{
    uint16_t payload_len;
    const uint8_t *payload;
    uint8_t type;

    type = coap_header_get_type(rx);
    payload = coap_packet_get_payload(rx, &payload_len);

    if (!IS_ENABLED(CONFIG_LOG_BACKEND_GOLIOTH) && payload) {
        LOG_HEXDUMP_DBG(payload, payload_len, "Payload");
    }
}

void main(void)
{
    int counter = 0;

    LOG_DBG("Start Logging sample");

    if (IS_ENABLED(CONFIG_GOLIOTH_SAMPLE_WIFI)) {
        LOG_INF("Connecting to WiFi");
        wifi_connect();
    }

    client->on_message = golioth_on_message;
    golioth_system_client_start();

    while (true) {
        LOG_INF("INFO: the counter is %d", counter);

        counter++;

        k_sleep(K_SECONDS(5));
    }
}
```
